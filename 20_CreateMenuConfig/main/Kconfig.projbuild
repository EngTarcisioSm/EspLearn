## 20_CreateMenuConfig/main/Kconfig.projbuild
```kconfig
menu "My Custom menu"

config MY_BOOL
    bool "select yes or no"

Config MY_STRING
    string "enter a string"
    default "hello world"
        help
            this is my help text description

config MY_CHOICE
    choice
        bool "select a choice"
            default OPTION_1
        config OPTION_1
            bool "this is option 1"
        config OPTION_1
            bool "this is option 2"
        config OPTION_1
            bool "this is option 3"   
        endchoice     
endmenu
```
